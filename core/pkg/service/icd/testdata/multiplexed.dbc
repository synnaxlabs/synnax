VERSION ""

NS_ :

BS_:

BU_: Ecu Gateway

BO_ 768 Diagnostics: 8 Ecu
 SG_ Mode M : 0|8@1+ (1,0) [0|255] "" Gateway
 SG_ Temperature m0 : 8|16@1- (0.1,0) [-3276.8|3276.7] "degC" Gateway
 SG_ Pressure m1 : 8|16@1+ (0.5,0) [0|32767.5] "kPa" Gateway
 SG_ Humidity m1 : 24|8@1+ (1,0) [0|100] "%" Gateway
 SG_ Uptime : 32|32@1+ (1,0) [0|4294967295] "s" Gateway

BA_DEF_ BO_ "GenMsgCycleTime" INT 0 65535;
BA_DEF_DEF_ "GenMsgCycleTime" 50;
VAL_ 768 Mode 0 "Thermal" 1 "Atmospheric" ;
